## boards/shields/shifter_test/Kconfig.defconfig
```kconfig
if SHIELD_SHIFTER_TEST_LEFT

# Name must be less than 16 characters long!
config ZMK_KEYBOARD_NAME
    default "Shifter Test"

config ZMK_SPLIT_ROLE_CENTRAL
    default y

endif

if SHIELD_SHIFTER_TEST_LEFT || SHIELD_SHIFTER_TEST_RIGHT

config ZMK_SPLIT
    default y

endif

if SHIELD_SHIFTER_TEST_DONGLE

# Name must be less than 16 characters long!
config ZMK_KEYBOARD_NAME
    default "Shifter Test"

config ZMK_SPLIT
    default y

config ZMK_SPLIT_ROLE_CENTRAL
    default y

config ZMK_SPLIT_BLE_CENTRAL_PERIPHERALS
  default 2

config BT_MAX_CONN
  default 7

config BT_MAX_PAIRED
  default 7

endif

# ---------------------
# Kconfig for shield "shifter_test_left" with board "nice_nano_v2"
# ---------------------
if BOARD_NICE_NANO_V2 && SHIELD_SHIFTER_TEST_LEFT

config SPI
    default y

endif

# ---------------------
# Kconfig for shield "shifter_test_right" with board "nice_nano_v2"
# ---------------------
if BOARD_NICE_NANO_V2 && SHIELD_SHIFTER_TEST_RIGHT

config SPI
    default y

config WS2812_STRIP
    default y

config I2C
    default y

config ZMK_DISPLAY
    default y

if ZMK_DISPLAY

config I2C
    default y

config SSD1306
    default y

endif # ZMK_DISPLAY

if LVGL

config LV_Z_VDB_SIZE
    default 64

config LV_DPI_DEF
    default 148

config LV_Z_BITS_PER_PIXEL
    default 1

choice LV_COLOR_DEPTH
    default LV_COLOR_DEPTH_1
endchoice

endif # LVGL

endif
```

## boards/shields/shifter_test/Kconfig.shield
```kconfig
config SHIELD_SHIFTER_TEST_LEFT
    def_bool $(shields_list_contains,shifter_test_left)
  
config SHIELD_SHIFTER_TEST_RIGHT
    def_bool $(shields_list_contains,shifter_test_right)
  
config SHIELD_SHIFTER_TEST_DONGLE
    def_bool $(shields_list_contains,shifter_test_dongle)
```
